// SPDX-License-Identifier: (GPL-2.0+ OR MIT)
/*
 * Copyright (c) 2024 Rockchip Electronics Co., Ltd.
 *
 */

&vccio_1v8_s0 {
	regulator-state-mem {
		regulator-on-in-suspend;
	};
};

&rockchip_suspend {
	status = "okay";
	rockchip,sleep-debug-en = <1>;
	rockchip,virtual-poweroff = <1>;
	rockchip,virtual-poweroff-irqs = <168>;

	rockchip,sleep-mode-config = <
		(0
		| RKPM_SLP_ARMOFF
		)
	>;
	rockchip,wakeup-config = <
		(0
		| RKPM_GPIO0_WKUP_EN
		| RKPM_PWM_WKUP_EN
		)
	>;
	rockchip,sleep-io-ret-config = <
		(0
		| RKPM_VCCIO3_RET_EN
		)
	>;

	rockchip,sleep-pin-config = <
		(0)
		(0)
	>;

	rockchip,regulator-on-before-mem = <&vdd_npu_s0>;
};
